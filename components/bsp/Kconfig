## components/bsp/Kconfig
```kconfig
menu "BSP"
    choice BSP_BOARD_NAME
        prompt "Board Name"
        default BSP_Box3
        help 
            Select the board
        
        config BSP_Box3
            bool "BSP_Box3"
            select BSP_ENABLE_DISPLAY
        config BSP_Dnesp32S3
            bool "BSP_Dnesp32S3"
            select BSP_ENABLE_DISPLAY
        config BSP_KxDemo
            bool "BSP_KxDemo"
        config BSP_None
            bool "None"
    endchoice

    config BSP_ENABLE_DISPLAY
        bool "Enable Display"
        default n
        help
            Enable Display
endmenu
```

## sdkconfig.defaults
```kconfig
CONFIG_BSP_KxDemo=y

#
# FLASH
#
CONFIG_ESPTOOLPY_FLASHSIZE_16MB=y
CONFIG_PARTITION_TABLE_CUSTOM=y

#
# ESP-TLS
#
CONFIG_ESP_TLS_INSECURE=y
CONFIG_ESP_TLS_SKIP_SERVER_CERT_VERIFY=y

#
# ESP PSRAM
#
CONFIG_SPIRAM=y
CONFIG_SPIRAM_MODE_OCT=y
CONFIG_SPIRAM_MALLOC_ALWAYSINTERNAL=4096
CONFIG_SPIRAM_TRY_ALLOCATE_WIFI_LWIP=y

#
# mbedTLS
#
# CONFIG_MBEDTLS_INTERNAL_MEM_ALLOC is not set
# CONFIG_MBEDTLS_EXTERNAL_MEM_ALLOC is not set
CONFIG_MBEDTLS_DEFAULT_MEM_ALLOC=y
# CONFIG_MBEDTLS_CUSTOM_MEM_ALLOC is not set

#
# ESP-Driver:I2C Configurations
#
CONFIG_I2C_ENABLE_SLAVE_DRIVER_VERSION_2=y

#
# ESP HTTPS OTA
#
CONFIG_ESP_HTTPS_OTA_ALLOW_HTTP=y

#
# ESP Speech Recognition
#
CONFIG_MODEL_IN_FLASH=y
# CONFIG_MODEL_IN_SDCARD is not set
CONFIG_AFE_INTERFACE_V1=y
# CONFIG_SR_NSN_WEBRTC is not set
CONFIG_SR_NSN_NSNET2=y
# CONFIG_SR_VADN_WEBRTC is not set
CONFIG_SR_VADN_VADNET1_MEDIUM=y

CONFIG_SR_MN_CN_MULTINET7_QUANT=y
CONFIG_SR_MN_EN_NONE=y

#
# Audio Codec Device Configuration
#
# CONFIG_CODEC_I2C_BACKWARD_COMPATIBLE is not set

#
# BLE
#
CONFIG_BT_ENABLED=y
CONFIG_BT_GATTC_ENABLE=n
CONFIG_BT_BLE_SMP_ENABLE=n
CONFIG_BT_BLE_BLUFI_ENABLE=y
CONFIG_MBEDTLS_HARDWARE_MPI=n
CONFIG_MBEDTLS_DHM_C=y
# CONFIG_BT_BLE_50_FEATURES_SUPPORTED is not set
CONFIG_BT_BLE_42_FEATURES_SUPPORTED=y
```
